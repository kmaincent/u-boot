## board/congatec/cgtsx8x/Kconfig
```kconfig
if TARGET_CONGA_SX8X

config SYS_BOARD
	default "cgtsx8x"

config SYS_VENDOR
	default "congatec"

config SYS_CONFIG_NAME
	default "cgtsx8x"

menu "congatec SX8X misc"

config CGT_CM4_PART_DET
	bool "Enable detection of CM4 partition state at board late init"
	default y
	help
	 This option enables autodetection of the CM4 partition state
	 at board late init. If enabled (default), the CM4 partition
	 state (started, not started) is printed out (e.g. to serial
	 terminal) on startup.

config CGT_ENV_IS_IN_MMC_AUTOADAPT
	bool "Enable automated mmcdev/mmcroot adaption (ENV_IS_IN_MMC)"
	depends on ENV_IS_IN_MMC
	default n
	help
	 This option enables autoadaption of the environment variables
	 mmcdev and mmcroot with regard to the MMC device holding the
	 environment.
	 If environment is not stored at an MMC device, the
	 environment variables mmcdev and mmcroot are NOT adapted.

menu "SX8X ethernet interface selection"

config CGT_ENABLE_FEC0
	bool "Enable FEC0"
	default y
	depends on ARM && TARGET_CONGA_SX8X

config CGT_ENABLE_FEC1
	bool "Enable FEC1"
	default y
	depends on ARM && TARGET_CONGA_SX8X

endmenu

choice
	prompt "SX8X Memory Configuration"
        default CGT_SX8X_MEM_VAR_2GB

config CGT_SX8X_MEM_VAR_1GB
	bool "1GB"

config CGT_SX8X_MEM_VAR_2GB
	bool "2GB"

config CGT_SX8X_MEM_VAR_4GB
	bool "4GB"

config CGT_SX8X_MEM_VAR_3GB_LEGACY
	bool "3GB - will be removed soon!"

endchoice

endmenu

source "board/freescale/common/Kconfig"

endif
```

## board/ti/am57xx/Kconfig
```kconfig
if TARGET_AM57XX_EVM

config SYS_BOARD
	default "am57xx"

config SYS_VENDOR
	default "ti"

config SYS_CONFIG_NAME
	default "am57xx_evm"

config HAS_CAPE_SCAN
	bool
	default y

source "board/ti/common/Kconfig"

endif
```

## configs/cgtsx8x_defconfig
```kconfig
CONFIG_ARM=y
CONFIG_ARCH_IMX8=y
CONFIG_SYS_TEXT_BASE=0x80020000
CONFIG_SYS_MALLOC_F_LEN=0x8000
CONFIG_ENV_SIZE=0x2000
CONFIG_ENV_OFFSET=0x3fe000
CONFIG_DM_GPIO=y
CONFIG_IMX_CONTAINER_CFG="board/freescale/imx8qxp_mek/uboot-container.cfg"
CONFIG_TARGET_CONGA_SX8X=y
CONFIG_USE_TINY_PRINTF=y
CONFIG_NR_DRAM_BANKS=8
CONFIG_PANIC_HANG=y
CONFIG_OF_SYSTEM_SETUP=y
CONFIG_SYS_EXTRA_OPTIONS="IMX_CONFIG=board/freescale/imx8qxp_mek/imximage.cfg"
CONFIG_BOOTDELAY=3
CONFIG_LOG=y
CONFIG_HUSH_PARSER=y
CONFIG_CMD_CPU=y
# CONFIG_BOOTM_NETBSD is not set
# CONFIG_CMD_IMPORTENV is not set
CONFIG_CMD_CLK=y
CONFIG_CMD_DM=y
CONFIG_CMD_GPIO=y
CONFIG_CMD_I2C=y
CONFIG_CMD_MMC=y
CONFIG_CMD_DHCP=y
CONFIG_CMD_MII=y
CONFIG_CMD_PING=y
CONFIG_CMD_CACHE=y
CONFIG_CMD_EXT2=y
CONFIG_CMD_EXT4=y
CONFIG_CMD_EXT4_WRITE=y
CONFIG_CMD_FAT=y
CONFIG_DEFAULT_DEVICE_TREE="imx8qxp-cgtsx8x"
CONFIG_ENV_IS_IN_MMC=y
CONFIG_SYS_RELOC_GD_ENV_ADDR=y
CONFIG_NET_RANDOM_ETHADDR=y
CONFIG_CLK_IMX8=y
CONFIG_CPU=y
CONFIG_MXC_GPIO=y
CONFIG_DM_PCA953X=y
CONFIG_DM_I2C=y
CONFIG_SYS_I2C_IMX_LPI2C=y
# CONFIG_I2C_MUX=y
# CONFIG_I2C_MUX_PCA954x=y
CONFIG_MISC=y
CONFIG_DM_MMC=y
CONFIG_SUPPORT_EMMC_BOOT=y
CONFIG_FSL_USDHC=y
CONFIG_MMC_IO_VOLTAGE=y
CONFIG_MMC_UHS_SUPPORT=y
CONFIG_MMC_HS400_SUPPORT=y
CONFIG_EFI_PARTITION=y
CONFIG_PHYLIB=y
CONFIG_PHY_ADDR_ENABLE=y
CONFIG_PHY_ATHEROS=y
# CONFIG_DM_ETH=y
CONFIG_PHY_GIGE=y
CONFIG_FEC_MXC_SHARE_MDIO=y
CONFIG_FEC_MXC_MDIO_BASE=0x5B040000
CONFIG_FEC_MXC=y
CONFIG_MII=y
CONFIG_PINCTRL=y
CONFIG_PINCTRL_IMX8=y
CONFIG_POWER_DOMAIN=y
CONFIG_IMX8_POWER_DOMAIN=y
CONFIG_DM_REGULATOR=y
CONFIG_DM_REGULATOR_FIXED=y
CONFIG_DM_REGULATOR_GPIO=y
CONFIG_DM_SERIAL=y
CONFIG_FSL_LPUART=y
# CONFIG_EFI_LOADER is not set

CONFIG_CMD_FUSE=y
CONFIG_SMC_FUSE=y
CONFIG_CMD_MEMTEST=y

CONFIG_IMX_BOOTAUX=y

CONFIG_DM_THERMAL=y
CONFIG_IMX_SCU_THERMAL=y

CONFIG_SPI=y
CONFIG_FSL_FSPI=y
CONFIG_DM_SPI=y
CONFIG_DM_SPI_FLASH=y
CONFIG_SPI_FLASH=y
# CONFIG_SPI_FLASH_4BYTES_ADDR=y
CONFIG_SPI_FLASH_WINBOND=y
CONFIG_CMD_SF=y
CONFIG_SF_DEFAULT_BUS=0
CONFIG_SF_DEFAULT_CS=0
CONFIG_SF_DEFAULT_SPEED=40000000
CONFIG_SF_DEFAULT_MODE=0

CONFIG_USB_XHCI_HCD=y
CONFIG_USB_XHCI_IMX8=y
CONFIG_DM_USB=y
CONFIG_DM_USB_GADGET=y
CONFIG_USB=y
# CONFIG_USB_TCPC=y
CONFIG_USB_GADGET=y
# CONFIG_CI_UDC=y
CONFIG_USB_GADGET_DOWNLOAD=y
CONFIG_USB_GADGET_MANUFACTURER="FSL"
CONFIG_USB_GADGET_VENDOR_NUM=0x0525
CONFIG_USB_GADGET_PRODUCT_NUM=0xa4a5
# CONFIG_USB_CDNS3=y
# CONFIG_USB_CDNS3_GADGET=y
CONFIG_USB_GADGET_DUALSPEED=y
CONFIG_CDNS3_USB_PHY=y
CONFIG_PHY=y

CONFIG_SDP_LOADADDR=0x80400000

CONFIG_FASTBOOT=y
CONFIG_USB_FUNCTION_FASTBOOT=y
CONFIG_CMD_FASTBOOT=y
CONFIG_ANDROID_BOOT_IMAGE=y
CONFIG_FASTBOOT_UUU_SUPPORT=y
CONFIG_FASTBOOT_BUF_ADDR=0x82800000
CONFIG_FASTBOOT_BUF_SIZE=0x40000000
CONFIG_FASTBOOT_FLASH=y
CONFIG_FASTBOOT_USB_DEV=1

CONFIG_SYS_I2C_IMX_VIRT_I2C=y
# CONFIG_I2C_MUX_IMX_VIRT=y
CONFIG_IMX_VSERVICE_SHARED_BUFFER=0x90400000

CONFIG_BOOTAUX_RESERVED_MEM_BASE=0x88000000
CONFIG_BOOTAUX_RESERVED_MEM_SIZE=0x08000000

CONFIG_CGT_CM4_PART_DET=y
# CONFIG_CGT_ENV_IS_IN_MMC_AUTOADAPT is not set
CONFIG_CGT_ENABLE_FEC0=y
CONFIG_CGT_ENABLE_FEC1=y

CONFIG_REGMAP=y
CONFIG_SYSCON=y
CONFIG_PCI=y
CONFIG_DM_PCI=y

CONFIG_USB_PORT_AUTO=y

CONFIG_SNVS_SEC_SC=y
CONFIG_OF_LIBFDT_OVERLAY=y

CONFIG_VIDEO_IMXDPUV1=y
CONFIG_DM_VIDEO=y
CONFIG_VIDEO_IMX8_LVDS=y
CONFIG_VIDEO_IT6263_BRIDGE=y
CONFIG_SYS_WHITE_ON_BLACK=y
```

## configs/mx6qsabresd_defconfig
```kconfig
CONFIG_SYS_EXTRA_OPTIONS="IMX_CONFIG=board/freescale/mx6sabresd/mx6q_4x_mt41j128.cfg,MX6Q,SYS_USE_SPINOR"
CONFIG_ARM=y
CONFIG_TARGET_MX6SABRESD=y
CONFIG_DM=y
CONFIG_DM_THERMAL=y
CONFIG_USB_EHCI_HCD=y
CONFIG_USB_EHCI=y
CONFIG_USB_STORAGE=y
```
